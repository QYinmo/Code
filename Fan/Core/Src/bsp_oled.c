/**
 * ============================================================================
 *  OLED SSD1306 显示驱动实现 (I2C, 128x64)
 *  通信协议: I2C, 地址 0x3C
 *  供电: 3.3V
 *
 *  显示缓存: 1024 字节 (128 × 64 / 8)
 *  字体: 内置 6x8 ASCII 字体
 * ============================================================================
 */
#include "bsp_oled.h"
#include <string.h>
#include <stdio.h>

/* I2C 句柄指针 (初始化时保存) */
static I2C_HandleTypeDef *oled_hi2c = NULL;

/* 显示缓存 128×64 = 1024 bytes */
static uint8_t OLED_Buffer[OLED_WIDTH * OLED_HEIGHT / 8];

/* 上一帧缓存, 用于脏检测 */
static uint8_t OLED_PrevBuffer[OLED_WIDTH * OLED_HEIGHT / 8];

/* ======================== 6x8 ASCII 字体表 ======================== */
/* 每个字符 6 列, 每列 8 位 (1 页高度) */
static const uint8_t Font_6x8[][6] = {
    {0x00,0x00,0x00,0x00,0x00,0x00}, /* 空格 (32) */
    {0x00,0x00,0x5F,0x00,0x00,0x00}, /* ! */
    {0x00,0x07,0x00,0x07,0x00,0x00}, /* " */
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    {0x08,0x08,0x2A,0x1C,0x08,0x00}, /* ~ -> 右箭头 */
};

/* ======================== 底层通信 ======================== */

/**
 * @brief 写命令
 */
static void OLED_WriteCmd(uint8_t cmd)
{
    uint8_t data[2] = {0x00, cmd};  /* Co=0, D/C#=0 (命令) */
    HAL_I2C_Master_Transmit(oled_hi2c, OLED_I2C_ADDR, data, 2, 50);
}

/**
 * @brief 批量写数据
 */
static void OLED_WriteData(uint8_t *buf, uint16_t len)
{
    /* 分块发送, 每块最多 128 字节 + 1 字节前缀 */
    uint16_t i = 0;
    uint8_t tmp[129];
    while (i < len) {
        uint16_t chunk = (len - i > 128) ? 128 : (len - i);
        tmp[0] = 0x40;  /* Co=0, D/C#=1 (数据) */
        memcpy(&tmp[1], &buf[i], chunk);
        HAL_I2C_Master_Transmit(oled_hi2c, OLED_I2C_ADDR, tmp, chunk + 1, 100);
        i += chunk;
    }
}

/* ======================== 公开接口 ======================== */

void OLED_Init(I2C_HandleTypeDef *hi2c)
{
    oled_hi2c = hi2c;

    HAL_Delay(100);  /* 等待 OLED 上电稳定 */

    /* 初始化命令序列 */
    OLED_WriteCmd(0xAE);  /* 关显示 */
    OLED_WriteCmd(0x20);  /* 设置寻址模式 */
    OLED_WriteCmd(0x00);  /* 水平寻址模式 */
    OLED_WriteCmd(0xB0);  /* 设置页起始地址 */
    OLED_WriteCmd(0xC8);  /* COM 扫描方向: 从下到上 */
    OLED_WriteCmd(0x00);  /* 设置列低地址 */
    OLED_WriteCmd(0x10);  /* 设置列高地址 */
    OLED_WriteCmd(0x40);  /* 设置显示起始行 */
    OLED_WriteCmd(0x81);  /* 设置对比度 */
    OLED_WriteCmd(0xCF);  /* 对比度值 */
    OLED_WriteCmd(0xA1);  /* 段重映射: 0->127 */
    OLED_WriteCmd(0xA6);  /* 正常显示 (非反显) */
    OLED_WriteCmd(0xA8);  /* 设置复用比 */
    OLED_WriteCmd(0x3F);  /* 1/64 duty */
    OLED_WriteCmd(0xA4);  /* 显示跟随 RAM */
    OLED_WriteCmd(0xD3);  /* 设置显示偏移 */
    OLED_WriteCmd(0x00);  /* 无偏移 */
    OLED_WriteCmd(0xD5);  /* 设置时钟分频 */
    OLED_WriteCmd(0x80);  /* 默认值 */
    OLED_WriteCmd(0xD9);  /* 设置预充电周期 */
    OLED_WriteCmd(0xF1);  /* */
    OLED_WriteCmd(0xDA);  /* 设置 COM 引脚配置 */
    OLED_WriteCmd(0x12);  /* */
    OLED_WriteCmd(0xDB);  /* 设置 VCOMH */
    OLED_WriteCmd(0x40);  /* */
    OLED_WriteCmd(0x8D);  /* 电荷泵 */
    OLED_WriteCmd(0x14);  /* 使能电荷泵 */
    OLED_WriteCmd(0xAF);  /* 开显示 */

    OLED_Clear();
    memset(OLED_PrevBuffer, 0xFF, sizeof(OLED_PrevBuffer));
    OLED_Refresh();
}

void OLED_Clear(void)
{
    memset(OLED_Buffer, 0x00, sizeof(OLED_Buffer));
}

void OLED_Refresh(void)
{
    for (uint8_t page = 0; page < 8; page++) {
        uint16_t offset = page * OLED_WIDTH;
        /* 跳过与上一帧相同的页 */
        if (memcmp(&OLED_Buffer[offset], &OLED_PrevBuffer[offset], OLED_WIDTH) == 0)
            continue;
        OLED_WriteCmd(0xB0 + page);
        OLED_WriteCmd(0x00);
        OLED_WriteCmd(0x10);
        OLED_WriteData(&OLED_Buffer[offset], OLED_WIDTH);
        memcpy(&OLED_PrevBuffer[offset], &OLED_Buffer[offset], OLED_WIDTH);
    }
}

void OLED_DrawPoint(uint8_t x, uint8_t y, uint8_t color)
{
    if (x >= OLED_WIDTH || y >= OLED_HEIGHT) return;

    if (color)
        OLED_Buffer[x + (y / 8) * OLED_WIDTH] |= (1 << (y % 8));
    else
        OLED_Buffer[x + (y / 8) * OLED_WIDTH] &= ~(1 << (y % 8));
}

void OLED_ShowString(uint8_t x, uint8_t y, const char *str)
{
    while (*str) {
        uint8_t ch = *str;
        if (ch < 32 || ch > 126) ch = 32;  /* 范围外用空格代替 */
        uint8_t idx = ch - 32;

        /* 写入缓存 */
        for (uint8_t i = 0; i < 6; i++) {
            if (x + i < OLED_WIDTH) {
                OLED_Buffer[(x + i) + y * OLED_WIDTH] = Font_6x8[idx][i];
            }
        }
        x += 6;
        if (x >= OLED_WIDTH) break;
        str++;
    }
}

void OLED_SetInverse(bool inverse)
{
    OLED_WriteCmd(inverse ? 0xA7 : 0xA6);
}
